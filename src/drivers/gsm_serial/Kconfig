## src/drivers/gsm_serial/Kconfig
```kconfig
menuconfig DRIVERS_GSM_SERIAL
	bool "gsm_serial"
	default n
	---help---
		Enable support for serial GSM driver
```

## src/drivers/simple_pwm/Kconfig
```kconfig
menuconfig DRIVERS_SIMPLE_PWM
	bool "simple_pwm"
	default n
	---help---
		Enable support for simple_pwm
```
