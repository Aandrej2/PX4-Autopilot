## src/modules/record_data/Kconfig
```kconfig
menuconfig MODULES_RECORD_DATA
	bool "record_data"
	default n
	---help---
		Enable support for recording sensor data
```

## src/modules/rocket_commander/Kconfig
```kconfig
menuconfig MODULES_ROCKET_COMMANDER
	bool "rocket_commander"
	default n
	---help---
		Enable support for rocket commander
```
